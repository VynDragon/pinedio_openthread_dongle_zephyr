## west.yml
```yaml
manifest:
  remotes:
    - name: zephyrproject-rtos
      url-base: https://github.com/zephyrproject-rtos

  projects:
    - name: zephyr
      remote: zephyrproject-rtos
      revision: pull/120800/head
      import:
        name-allowlist:
          - hal_bouffalolab
          - openthread
          - mbedtls
          - tf-psa-crypto
```
